## dts/bindings/sensor/bosch,bma400-i2c.yaml
```yaml
# Copyright (c) 2026 bytesatwork AG
# SPDX-License-Identifier: Apache-2.0

description: |
  Bosch BMA400 3-axis acceleration sensors in I2C mode.  See more info at:
  https://www.bosch-sensortec.com/products/motion-sensors/accelerometers/

compatible: "bosch,bma400"

include: [sensor-device.yaml, i2c-device.yaml, "bosch,bma400-common.yaml"]
```
