## drivers/led/Kconfig.is31fl3216a
```kconfig
# Copyright (c) 2023 Endor AG
# SPDX-License-Identifier: Apache-2.0

config IS31FL3216A
	bool "IS31FL3216A LED driver"
	default n
	select I2C
	help
	  Enable LED driver for IS31FL3216A.
```

## dts/bindings/led/lumissil,is31fl3216a.yaml
```yaml
# Copyright (c) 2023 Endor AG
# SPDX-License-Identifier: Apache-2.0

description: Lumissil Microsystems IS31FL3216A

compatible: "lumissil,is31fl3216a"

include: i2c-device.yaml
```
